## base_external/configs/aesd_qemu_defconfig
```kconfig
BR2_aarch64=y
BR2_TARGET_GENERIC_ROOT_PASSWD="root"
BR2_LINUX_KERNEL=y
BR2_LINUX_KERNEL_USE_CUSTOM_CONFIG=y
BR2_PACKAGE_DROPBEAR=y
BR2_PACKAGE_AESD_ASSIGNMENTS=y
```
